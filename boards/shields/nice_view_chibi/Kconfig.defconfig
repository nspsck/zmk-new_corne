## boards/shields/nice_view_chibi/Kconfig.defconfig
```kconfig
# Adapted from ZMK's nice_view shield.
# Copyright (c) 2023 The ZMK Contributors
# SPDX-License-Identifier: MIT

if SHIELD_NICE_VIEW_CHIBI

config LV_Z_VDB_SIZE
    default 100

config LV_DPI_DEF
    default 161

config LV_Z_BITS_PER_PIXEL
    default 1

choice LV_COLOR_DEPTH
    default LV_COLOR_DEPTH_1
endchoice

choice ZMK_DISPLAY_WORK_QUEUE
    default ZMK_DISPLAY_WORK_QUEUE_DEDICATED
endchoice

choice ZMK_DISPLAY_STATUS_SCREEN
    default ZMK_DISPLAY_STATUS_SCREEN_CUSTOM
endchoice

config LV_Z_MEM_POOL_SIZE
    default 4096 if ZMK_DISPLAY_STATUS_SCREEN_CUSTOM

config LV_USE_IMG
    default y if ZMK_DISPLAY_STATUS_SCREEN_CUSTOM

endif # SHIELD_NICE_VIEW_CHIBI
```

## boards/shields/nice_view_chibi/Kconfig.shield
```kconfig
# SPDX-License-Identifier: MIT

config SHIELD_NICE_VIEW_CHIBI
    def_bool $(shields_list_contains,nice_view_chibi)
```
